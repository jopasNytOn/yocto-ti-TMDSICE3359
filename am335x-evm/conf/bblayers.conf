## am335x-evm/conf/bblayers.conf
```bitbake
# This template file was created by taking the oe-core/meta/conf/bblayers.conf
# file and removing the BBLAYERS section at the end.

# LAYER_CONF_VERSION is increased each time build/conf/bblayers.conf
# changes incompatibly
LCONF_VERSION = "7"

BBPATH = "${TOPDIR}"
BBFILES ?= ""

# Layers configured by oe-core-setup script
BBLAYERS += " \
	/opt/git_workspace/yocto-ti-TMDSICE3359-dunfell/sources/meta-jopasnyton \
	/opt/git_workspace/yocto-ti-TMDSICE3359-dunfell/tisdk/sources/meta-custom \
	/opt/git_workspace/yocto-ti-TMDSICE3359-dunfell/tisdk/sources/meta-arago/meta-arago-distro \
	/opt/git_workspace/yocto-ti-TMDSICE3359-dunfell/tisdk/sources/meta-arago/meta-arago-extras \
	/opt/git_workspace/yocto-ti-TMDSICE3359-dunfell/tisdk/sources/meta-qt5 \
	/opt/git_workspace/yocto-ti-TMDSICE3359-dunfell/tisdk/sources/meta-virtualization \
	/opt/git_workspace/yocto-ti-TMDSICE3359-dunfell/tisdk/sources/meta-openembedded/meta-networking \
	/opt/git_workspace/yocto-ti-TMDSICE3359-dunfell/tisdk/sources/meta-openembedded/meta-python \
	/opt/git_workspace/yocto-ti-TMDSICE3359-dunfell/tisdk/sources/meta-openembedded/meta-oe \
	/opt/git_workspace/yocto-ti-TMDSICE3359-dunfell/tisdk/sources/meta-openembedded/meta-gnome \
	/opt/git_workspace/yocto-ti-TMDSICE3359-dunfell/tisdk/sources/meta-openembedded/meta-filesystems \
	/opt/git_workspace/yocto-ti-TMDSICE3359-dunfell/tisdk/sources/meta-ti \
	/opt/git_workspace/yocto-ti-TMDSICE3359-dunfell/tisdk/sources/meta-arm/meta-arm \
	/opt/git_workspace/yocto-ti-TMDSICE3359-dunfell/tisdk/sources/meta-arm/meta-arm-toolchain \
	/opt/git_workspace/yocto-ti-TMDSICE3359-dunfell/tisdk/sources/oe-core/meta \
	/opt/git_workspace/yocto-ti-TMDSICE3359-dunfell/tisdk/sources/meta-psdkla \
	/opt/git_workspace/yocto-ti-TMDSICE3359-dunfell/tisdk/sources/meta-aws \
"
```
